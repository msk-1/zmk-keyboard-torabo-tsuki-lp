## config/west.yml
```yaml
manifest:
  remotes:
    - name: zmkfirmware
      url-base: https://github.com/zmkfirmware
    - name: sekigon-gonnoc
      url-base: https://github.com/sekigon-gonnoc
    - name: yamaryu211
      url-base: https://github.com/yamaryu211
    - name: kot149
      url-base: https://github.com/kot149
  projects:
    - name: zmk
      remote: zmkfirmware
      revision: v0.3
      import: app/west.yml
    - name: zmk-component-bmp-boost
      remote: sekigon-gonnoc
      import: west.yml
      revision: v0.2
    - name: zmk-feature-status-led
      remote: sekigon-gonnoc
      revision: main
    - name: zmk-driver-paw3222
      remote: sekigon-gonnoc
      revision: torabo-tsuki
    - name: zmk-driver-iqs7211e
      remote: sekigon-gonnoc
    - name: zmk-feature-cdc-acm-bootloader-trigger
      remote: sekigon-gonnoc
      revision: v0.2
    - name: zmk-feature-non-lipo-battery-management
      remote: sekigon-gonnoc
      revision: main
    # オートマウスレイヤー（閾値対応、roBaと同じ）
    - name: zmk-input-processor-temp-layer-threshold
      remote: yamaryu211
      revision: main
    # Layout Shift (JIS配列対応、roBaと同じ)
    - name: zmk-layout-shift
      remote: kot149
      revision: v1
  self:
    path: config
```

## dts/bindings/behaviors/zmk,behavior-battery-led.yaml
```yaml
# バッテリー残量をLEDの点滅回数(1〜5回)で表示するビヘイビア

description: Battery level LED indicator behavior (blinks 1-5 times)

compatible: "zmk,behavior-battery-led"

include: zero_param.yaml

properties:
  led:
    type: phandle
    required: true
    description: LED node (gpio-leds child) to blink
  blink-ms:
    type: int
    default: 150
    description: LED on duration per blink in milliseconds
  pause-ms:
    type: int
    default: 250
    description: LED off duration between blinks in milliseconds
```
